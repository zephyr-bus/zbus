## Kconfig
```kconfig
module = ZBUS
module-str = zbus
source "subsys/logging/Kconfig.template.log_config"

config ZBUS_IPC_BRIDGE
  bool "Enable the IPC bridge"
  default n

menu "IPC bridge"
visible if ZBUS_IPC_BRIDGE

config ZBUS_IPC_BRIDGE_MAX_BUFFER_LEN
  int "The maximum channel size"
  default 256

endmenu

config ZBUS_ASSERTS
  bool "Enable asserts for zbus implementation"
  default y

config ZBUS_MONITOR_THREAD_STACK_SIZE
  int "Size of the monitor thead stack"
  default 2048

config ZBUS_MONITOR_THREAD_PRIORITY
  int "Size of the monitor thead stack"
  default 0

source "Kconfig.zephyr"
```

## Kconfig.zbus
```kconfig
config ZBUS
	bool "Zbus messaging bus"
	help
	  Zbus messaging bus

if ZBUS 
config ZBUS_LOG
  bool "Enable log for zbus usage"
  depends on LOG
  default n

config ZBUS_OFFENSIVE_PROG
  bool "Enable asserts for zbus implementation"
  default n

config ZBUS_MONITOR_THREAD_STACK_SIZE
  int "Size of the monitor thread stack"
  default 2048

config ZBUS_MONITOR_THREAD_PRIORITY
  int "Size of the monitor thread stack"
  default 0

config ZBUS_EVENT_DISPATCHER_SEMAPHORE_TIMEOUT
  int "Timeout in milliseconds the event dispatcher consider when using semaphores"
  default 50

config ZBUS_EVENT_DISPATCHER_QUEUE_TIMEOUT
  int "Timeout in milliseconds the event dispatcher consider when using queues"
  default 50

config ZBUS_CHANNEL_USER_DATA
  bool "Enable the Zbus user data field in the channel structure."
  default n
  help
    This field is a user data where the developer can manipulate freely after claiming the channel.
    It can be used to extends zbus features. The uart_bridge and remote mock samples illustrate the usage.

config ZBUS_CHANNEL_USER_DATA_SIZE
  int "Channel user data size in bytes"
  default 4
  help
    The user data field is an uint8_t array. This configuration enables the developer to choose the field size.
    All the channel will have the same size of user data. Use that carefully to avoid unnecessary memory usage.

config ZBUS_EXT
  bool "Enable the Zbus extension"
  default n

if ZBUS_EXT

    config ZBUS_EXT_THREAD_STACK_SIZE
      int "Size of the monitor thread stack"
      default 2048

    config ZBUS_EXT_THREAD_PRIORITY
      int "Size of the monitor thread stack"
      default 1

endif # ZBUS_EXT

module = ZBUS
module-str = zbus
source "subsys/logging/Kconfig.template.log_config"

endif # ZBUS
```

## build/Kconfig/Kconfig.modules
```kconfig
menu "hal_nordic (/home/rodrigo/Cloud/Projects/zephyrproject/modules/hal/nordic)"
osource "$(ZEPHYR_HAL_NORDIC_KCONFIG)"
config ZEPHYR_HAL_NORDIC_MODULE
	bool
	default y
endmenu
menu "mbedtls (/home/rodrigo/Cloud/Projects/zephyrproject/modules/crypto/mbedtls)"
osource "$(ZEPHYR_MBEDTLS_KCONFIG)"
config ZEPHYR_MBEDTLS_MODULE
	bool
	default y
endmenu
menu "sof (/home/rodrigo/Cloud/Projects/zephyrproject/modules/audio/sof)"
osource "/home/rodrigo/Cloud/Projects/zephyrproject/modules/audio/sof/zephyr/Kconfig"
config ZEPHYR_SOF_MODULE
	bool
	default y
endmenu
menu "TraceRecorder (/home/rodrigo/Cloud/Projects/zephyrproject/modules/debug/TraceRecorder)"
osource "/home/rodrigo/Cloud/Projects/zephyrproject/modules/debug/TraceRecorder/kernelports/Zephyr/Kconfig"
config ZEPHYR_TRACERECORDER_MODULE
	bool
	default y
endmenu
menu "trusted-firmware-m (/home/rodrigo/Cloud/Projects/zephyrproject/modules/tee/tfm)"
osource "$(ZEPHYR_TRUSTED_FIRMWARE_M_KCONFIG)"
config ZEPHYR_TRUSTED_FIRMWARE_M_MODULE
	bool
	default y
endmenu
menu "nanopb (/home/rodrigo/Cloud/Projects/zephyrproject/modules/lib/nanopb)"
osource "$(ZEPHYR_NANOPB_KCONFIG)"
config ZEPHYR_NANOPB_MODULE
	bool
	default y
endmenu
menu "tensorflow (/home/rodrigo/Cloud/Projects/zephyrproject/modules/lib/tensorflow)"
osource "$(ZEPHYR_TENSORFLOW_KCONFIG)"
config ZEPHYR_TENSORFLOW_MODULE
	bool
	default y
endmenu
```

## build/Kconfig/Kconfig.shield
```kconfig
osource "/home/rodrigo/Cloud/Projects/zephyrproject/zephyr/boards/shields/*/Kconfig.shield"
```

## build/Kconfig/Kconfig.shield.defconfig
```kconfig
osource "/home/rodrigo/Cloud/Projects/zephyrproject/zephyr/boards/shields/*/Kconfig.defconfig"
```

## build/Kconfig/Kconfig.soc
```kconfig
osource "/home/rodrigo/Cloud/Projects/zephyrproject/zephyr/soc/$(ARCH)/*/Kconfig.soc"
```

## build/Kconfig/Kconfig.soc.arch
```kconfig
osource "/home/rodrigo/Cloud/Projects/zephyrproject/zephyr/soc/$(ARCH)/Kconfig"
osource "/home/rodrigo/Cloud/Projects/zephyrproject/zephyr/soc/$(ARCH)/*/Kconfig"
```

## build/Kconfig/Kconfig.soc.defconfig
```kconfig
osource "/home/rodrigo/Cloud/Projects/zephyrproject/zephyr/soc/$(ARCH)/*/Kconfig.defconfig"
```

## samples/uart_bridge/testcase.yaml
```yaml
tests:
  # section.subsection
  extension.publish_readin_interception_no_error:
    build_only: false
    platform_allow: native_posix qemu_cortex_m3
    tags: testing
```

## tests/integration/testcase.yaml
```yaml
tests:
  # section.subsection
  integration.module_interaction_no_error:
    build_only: false
    platform_allow: native_posix qemu_cortex_m3
    tags: testing
```

## tests/unittests/testcase.yaml
```yaml
tests:
  # section.subsection
  testing.channel_creation_and_init:
    build_only: false
    platform_allow: native_posix qemu_cortex_m3
    tags: testing
```

## tests/user_data/testcase.yaml
```yaml
tests:
  # section.subsection
  testing.channel_user_data:
    build_only: false
    platform_allow: native_posix qemu_cortex_m3
    tags: testing
```
