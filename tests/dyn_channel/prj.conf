## CMakeLists.txt
```
# SPDX-License-Identifier: Apache-2.0

cmake_minimum_required(VERSION 3.13.1)
find_package(Zephyr REQUIRED HINTS $ENV{ZEPHYR_BASE})
project(integration)
 set ( CMAKE_C_FLAGS "-save-temps")

# this will help zephyr to find the zbus_messages ans zbus_channels files 
zephyr_include_directories(
  "${CMAKE_CURRENT_SOURCE_DIR}/include"
)

list(APPEND HEADERS
  "${CMAKE_CURRENT_SOURCE_DIR}/include"
  )
list(
  APPEND SOURCES
  "${CMAKE_CURRENT_SOURCE_DIR}/src/core.c"
  "${CMAKE_CURRENT_SOURCE_DIR}/src/main.c"
  )

include_directories(${HEADERS})
target_sources(app PRIVATE ${SOURCES})
```

## prj.conf
```kconfig
CONFIG_ZTEST=y
CONFIG_ASSERT=y
CONFIG_LOG=y
CONFIG_HEAP_MEM_POOL_SIZE=256

CONFIG_ZBUS=y
CONFIG_ZBUS_LOG=y
CONFIG_ZBUS_LOG_LEVEL_DBG=y
```

## src/main.c
```c
/*
 * Copyright (c) 2016 Intel Corporation
 *
 * SPDX-License-Identifier: Apache-2.0
 */

#include <stdint.h>
#include <string.h>
#include <ztest.h>
#include "kernel.h"
#include "sys/util_macro.h"
#include "zbus.h"
#include "zbus_messages.h"
#include "ztest_assert.h"

#include <logging/log.h>
LOG_MODULE_DECLARE(zbus, CONFIG_ZBUS_LOG_LEVEL);

void s1_cb(zbus_chan_idx_t idx);
ZBUS_LISTENER_DECLARE(s1, s1_cb);


struct {
    uint8_t a;
    uint64_t b;
} my_random_data_expected = {0};

void s1_cb(zbus_chan_idx_t idx)
{
    struct external_data_msg *chan_message = NULL;
    struct zbus_channel *chan              = zbus_chan_get_by_index(idx);
    if (!zbus_chan_claim(chan, K_NO_WAIT)) {
        chan_message = (struct external_data_msg *) chan->message;
        memcpy(&my_random_data_expected, chan_message->reference,
               sizeof(my_random_data_expected));
        zbus_chan_finish(zbus_chan_get_by_index(idx));
    }
}

/**
 * @brief Test Asserts
 *
 * This test verifies various assert macros provided by ztest.
 *
 */
static void test_static(void)
{
    uint8_t static_memory[256]                    = {0};
    struct external_data_msg static_external_data = {.reference = static_memory,
                                                     .size      = 256};

    struct {
        uint8_t a;
        uint64_t b;
    } my_random_data = {.a = 10, .b = 200000};
    memcpy(static_memory, &my_random_data, sizeof(my_random_data));

    int err = ZBUS_CHAN_PUB(dyn_chan, static_external_data, K_NO_WAIT);
    zassert_false(err, "Allocation could not be performed");

    k_msleep(100);
    zassert_equal(my_random_data.a, my_random_data_expected.a, "It must be 10");
    zassert_equal(my_random_data.b, my_random_data_expected.b, "It must be 200000");
    struct external_data_msg edm = {0};
    ZBUS_CHAN_READ(dyn_chan, edm, K_NO_WAIT);
    zassert_equal(edm.reference, static_memory, "The pointer must be equal here");
}

/**
 * @brief Test Asserts
 *
 * This test verifies various assert macros provided by ztest.
 *
 */
static void test_malloc(void)
{
    uint8_t *dynamic_memory = k_malloc(128);
    zassert_true(dynamic_memory != NULL, "Memory could not be allocated");
    struct external_data_msg static_external_data = {.reference = dynamic_memory,
                                                     .size      = 128};
    struct {
        uint8_t a;
        uint64_t b;
    } my_random_data = {.a = 20, .b = 300000};

    memcpy(dynamic_memory, &my_random_data, sizeof(my_random_data));
    int err = ZBUS_CHAN_PUB(dyn_chan, static_external_data, K_NO_WAIT);
    zassert_false(err, "Allocation could not be performed");

    k_msleep(100);
    zassert_equal(my_random_data.a, my_random_data_expected.a, "It must be 10");
    zassert_equal(my_random_data.b, my_random_data_expected.b, "It must be 200000");
    struct external_data_msg *actual_message_data = NULL;
    err = zbus_chan_claim(ZBUS_CHAN_GET(dyn_chan), K_NO_WAIT);
    zassert_equal(err, 0, "Could not claim the channel");
    actual_message_data = (struct external_data_msg *) ZBUS_CHAN_GET(dyn_chan)->message;
    zassert_equal(actual_message_data->reference, dynamic_memory,
                  "The pointer must be equal here");
    k_free(actual_message_data->reference);
    actual_message_data->reference = NULL;
    actual_message_data->size      = 0;
    zbus_chan_finish(ZBUS_CHAN_GET(dyn_chan));
    struct external_data_msg expected_to_be_clean = {0};
    ZBUS_CHAN_READ(dyn_chan, expected_to_be_clean, K_NO_WAIT);
    zassert_is_null(expected_to_be_clean.reference,
                    "The current message reference should be NULL");
    zassert_equal(expected_to_be_clean.size, 0,
                  "The current message size should be zero");
}

void test_main(void)
{
    ztest_test_suite(framework_tests, ztest_unit_test(test_static),
                     ztest_unit_test(test_malloc));

    ztest_run_test_suite(framework_tests);
}
```

## include/zbus_channels.h
```c
ZBUS_CHAN_DEFINE(
    version,              /* Name */
    false,                /* On changes only */
    true,                 /* Read only */
    struct version,       /* Message type */
    NULL,                 /* Validator */
    ZBUS_OBSERVERS_EMPTY, /* observers */
    ZBUS_MSG_INIT(.major = 0, .minor = 1,
               .build = 1023) /* Initial value major 0, minor 1, build 1023 */
)
ZBUS_CHAN_DEFINE(
    sensor_data,          /* Name */
    true,                 /* On changes only */
    false,                /* Read only */
    struct sensor_data,   /* Message type */
    NULL,                 /* Validator */
    ZBUS_OBSERVERS_EMPTY, /* observers */
    ZBUS_MSG_INIT(0)      /* Initial value {0} */
)
ZBUS_CHAN_DEFINE(
    dyn_chan_no_subs,         /* Name */
    false,                    /* On changes only */
    false,                    /* Read only */
    struct external_data_msg, /* Message type */
    NULL,                     /* Validator */
    ZBUS_OBSERVERS_EMPTY,     /* observers */
    ZBUS_MSG_INIT(0)          /* Initial value {0} */
)
ZBUS_CHAN_DEFINE(
    dyn_chan,                 /* Name */
    true,                     /* On changes only */
    false,                    /* Read only */
    struct external_data_msg, /* Message type */
    NULL,                     /* Validator */
    ZBUS_OBSERVERS(s1),       /* observers */
    ZBUS_MSG_INIT(0)          /* Initial value {0} */
)
```

## include/zbus_messages.h
```c
#ifndef _ZBUS_MESSAGES_H_
#define _ZBUS_MESSAGES_H_
#include <zephyr.h>

struct version {
    uint8_t major;
    uint8_t minor;
    uint16_t build;
};

struct external_data_msg {
    void *reference;
    size_t size;
};

struct sensor_data {
    int a;
    int b;
};

struct net_pkt {
    char x;
    bool y;
};

struct action {
    bool status;
};

#endif  // _ZBUS_MESSAGES_H_
```

## src/core.c
```c
/**
 * @file      core.c
 * @brief     Header of
 * @date      Sun Nov 28 18:03:41 2021
 * @author    Rodrigo Peixoto
 * SPDX-License-Identifier: Apache-2.0
 *
 * This module
 */

#include "zbus.h"

#include <logging/log.h>
LOG_MODULE_DECLARE(zbus, CONFIG_ZBUS_LOG_LEVEL);

ZBUS_SUBSCRIBER_DECLARE(core, 10);

void core_thread(void)
{
}

K_THREAD_DEFINE(core_thread_id, 1024, core_thread, NULL, NULL, NULL, 3, 0, 0);
```
