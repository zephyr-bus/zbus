## CMakeLists.txt
```
# SPDX-License-Identifier: Apache-2.0

cmake_minimum_required(VERSION 3.13.1)
find_package(Zephyr REQUIRED HINTS $ENV{ZEPHYR_BASE})
project(integration)

# this will help zephyr to find the zbus_messages ans zbus_channels files 
zephyr_include_directories(
  "${CMAKE_CURRENT_SOURCE_DIR}/include"
)

list(APPEND HEADERS
  "${CMAKE_CURRENT_SOURCE_DIR}/include"
  )
list(
  APPEND SOURCES
  "${CMAKE_CURRENT_SOURCE_DIR}/src/core.c"
  "${CMAKE_CURRENT_SOURCE_DIR}/src/main.c"
  "${CMAKE_CURRENT_SOURCE_DIR}/src/peripheral.c"
  )

include_directories(${HEADERS})
target_sources(app PRIVATE ${SOURCES})
```

## prj.conf
```kconfig
CONFIG_ZTEST=y
CONFIG_ASSERT=y
CONFIG_ZBUS_EXT=y
CONFIG_LOG=y
CONFIG_ZBUS_LOG=y
CONFIG_ZBUS_LOG_LEVEL_DBG=y
```

## src/main.c
```c
/*
 * SPDX-License-Identifier: Apache-2.0
 */

#include <stdint.h>
#include <ztest.h>
#include "kernel.h"
#include "sys/util_macro.h"
#include "zbus.h"
#include "ztest_assert.h"

#include <logging/log.h>
LOG_MODULE_DECLARE(zbus, CONFIG_ZBUS_LOG_LEVEL);

extern struct k_msgq _zbus_ext_msgq;

/**
 * @brief Test Asserts
 *
 * This test verifies various assert macros provided by ztest.
 *
 */
static void test_01(void)
{
    zbus_chan_idx_t idx        = 0;
    union zbus_msg_var msg_data = {0};
    uint8_t count                   = 0;
    while (1) {
        if (!k_msgq_get(&_zbus_ext_msgq, &idx, K_FOREVER)) {
            struct zbus_channel *meta = zbus_chan_get_by_index(idx);
            zbus_chan_read(meta, (uint8_t *) &msg_data, meta->message_size, K_MSEC(500));
            switch (idx) {
            case sensor_data_chan_idx: {
                ++count;
                LOG_DBG("[Extension] receiving sensor data with a=%d, b=%d",
                        msg_data.sensor_data.a, msg_data.sensor_data.b);
                zassert_true(msg_data.sensor_data.a == count, "it must be %d", count);
                zassert_true(msg_data.sensor_data.b == (count * 10),
                             "it must be %d and not %d", count * 10,
                             msg_data.sensor_data.b);
                if (count == 4) {
                    return;
                }
            } break;
            case start_measurement_chan_idx: {
                LOG_DBG("[Extension] receiving start measurement with status %d",
                        msg_data.start_measurement.status);
                zassert_true(msg_data.start_measurement.status == (count % 2),
                             "it must be %d, and not %d", (count % 2),
                             msg_data.start_measurement.status);
            } break;
            case finish_chan_idx: {
                LOG_DBG("[Extension] receiving finish with status %d",
                        msg_data.finish.status);
                zassert_true(msg_data.finish.status == true, "it must be %d, and not %d",
                             true, msg_data.finish.status);

                struct action a = {false};
                LOG_DBG("[Extension] sending start measurement with status %d", a.status);
                zbus_chan_pub(zbus_chan_get_by_index(start_measurement_chan_idx),
                              (uint8_t *) &a, sizeof(a), K_MSEC(500), true);
            } break;
            default: {
                zassert_unreachable("Wrong idx send");
            }
            }
            memset(&msg_data, 0, sizeof(union zbus_msg_var));
        }
    }
}

void test_main(void)
{
    ztest_test_suite(framework_tests, ztest_unit_test(test_01));

    ztest_run_test_suite(framework_tests);
}
```

## include/zbus_channels.h
```c
ZBUS_CHAN_DEFINE(
    version,              /* Name */
    false,                /* On changes only */
    true,                 /* Read only */
    struct version,       /* Message type */
    NULL,                 /* Validator */
    ZBUS_OBSERVERS_EMPTY, /* observers */
    ZBUS_MSG_INIT(.major = 0, .minor = 1,
               .build = 1023) /* Initial value major 0, minor 1, build 1023 */
)
ZBUS_CHAN_DEFINE(
    sensor_data,          /* Name */
    true,                 /* On changes only */
    false,                /* Read only */
    struct sensor_data,   /* Message type */
    NULL,                 /* Validator */
    ZBUS_OBSERVERS_EMPTY, /* observers */
    ZBUS_MSG_INIT(0)      /* Initial value {0} */
)
ZBUS_CHAN_DEFINE(
    start_measurement,          /* Name */
    false,                      /* On changes only */
    false,                      /* Read only */
    struct action,              /* Message type */
    NULL,                       /* Validator */
    ZBUS_OBSERVERS(peripheral), /* observers */
    ZBUS_MSG_INIT(false)        /* Initial value */
)
ZBUS_CHAN_DEFINE(
    finish,               /* Name */
    false,                /* On changes only */
    false,                /* Read only */
    struct action,        /* Message type */
    NULL,                 /* Validator */
    ZBUS_OBSERVERS_EMPTY, /* observers */
    ZBUS_MSG_INIT(false)  /* Initial value */
)
```

## src/core.c
```c
/**
 * @file      core.c
 * @brief     Header of
 * @date      Sun Nov 28 18:03:41 2021
 * @author    Rodrigo Peixoto
 * SPDX-License-Identifier: Apache-2.0
 *
 * This module
 */

#include "zbus.h"

#include <logging/log.h>
LOG_MODULE_DECLARE(zbus, CONFIG_ZBUS_LOG_LEVEL);

ZBUS_SUBSCRIBER_DECLARE(core, 10);

void core_thread(void)
{
    struct action start = {false};
    LOG_DBG("[Core] sending start measurement with status %d", start.status);
    ZBUS_CHAN_PUB(start_measurement, start, K_MSEC(500));
    k_msleep(1000);

    start.status = true;
    LOG_DBG("[Core] sending start measurement with status %d", start.status);
    ZBUS_CHAN_PUB(start_measurement, start, K_MSEC(500));
    k_msleep(1000);

    start.status = false;
    LOG_DBG("[Core] sending start measurement with status %d", start.status);
    ZBUS_CHAN_PUB(start_measurement, start, K_MSEC(500));
    k_msleep(1000);

    start.status = true;
    LOG_DBG("[Core] sending finish with %d", start.status);
    ZBUS_CHAN_PUB(finish, start, K_MSEC(500));
}

K_THREAD_DEFINE(core_thread_id, 1024, core_thread, NULL, NULL, NULL, 3, 0, 0);
```

## src/peripheral.c
```c
/**
 * @file      peripheral.c
 * @brief     Header of
 * @date      Mon Nov 29 16:54:38 2021
 * @author    Rodrigo Peixoto
 * SPDX-License-Identifier: Apache-2.0
 *
 * This module
 */


#include <logging/log.h>
#include "zbus.h"
LOG_MODULE_DECLARE(zbus, CONFIG_ZBUS_LOG_LEVEL);

ZBUS_SUBSCRIBER_DECLARE(peripheral, 16);


void peripheral_thread(void)
{
    struct sensor_data sd  = {0, 0};
    zbus_chan_idx_t idx = 0;
    while (!k_msgq_get(peripheral.queue, &idx, K_FOREVER)) {
        sd.a += 1;
        sd.b += 10;
        LOG_DBG("[Peripheral] sending sensor data");
        ZBUS_CHAN_PUB(sensor_data, sd, K_MSEC(250));
    }
}

K_THREAD_DEFINE(peripheral_thread_id, 1024, peripheral_thread, NULL, NULL, NULL, 3, 0, 0);
```
