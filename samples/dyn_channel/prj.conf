## CMakeLists.txt
```
# SPDX-License-Identifier: Apache-2.0

cmake_minimum_required(VERSION 3.13.1)

# set(CMAKE_C_FLAGS "-save-temps")

find_package(Zephyr REQUIRED HINTS $ENV{ZEPHYR_BASE})
project(benchmark)

# this will help zephyr to find the zbus_messages ans zbus_channels files 
zephyr_include_directories(
  "${CMAKE_CURRENT_SOURCE_DIR}/include"
)

list(APPEND HEADERS
  "${CMAKE_CURRENT_SOURCE_DIR}/include"
  )
list(
  APPEND SOURCES
  "${CMAKE_CURRENT_SOURCE_DIR}/src/main.c"
  )

include_directories(${HEADERS})
target_sources(app PRIVATE ${SOURCES})
```

## sample.yaml
```
sample:
  name: Dynamic channel
common:
  tags: zbus
  timeout: 10
  harness: console
  harness_config:
    type: multi_line
    ordered: true
    regex:
     - " -> Sample dynamic filter version 0.1-1"
     - "Header: filter=0,body_size=00; Body:(.*)"
     - "Header: filter=1,body_size=01; Body: 00"
     - "Header: filter=0,body_size=02; Body: 0202"
     - "Header: filter=1,body_size=03; Body: 000000"
     - "Header: filter=0,body_size=04; Body: 04040404"
     - "Header: filter=1,body_size=05; Body: 0000000000"
     - "Header: filter=0,body_size=06; Body: 060606060606"
     - "Header: filter=1,body_size=07; Body: 00000000000000"
     - "Header: filter=0,body_size=08; Body: 0808080808080808"
     - "Header: filter=1,body_size=09; Body: 000000000000000000"
     - "Header: filter=0,body_size=10; Body: 0A0A0A0A0A0A0A0A0A0A"
     - "Header: filter=1,body_size=11; Body: 0000000000000000000000"
     - "Header: filter=0,body_size=12; Body: 0C0C0C0C0C0C0C0C0C0C0C0C"
     - "Header: filter=1,body_size=13; Body: 00000000000000000000000000"
     - "Header: filter=0,body_size=14; Body: 0E0E0E0E0E0E0E0E0E0E0E0E0E0E"
     - "Header: filter=1,body_size=15; Body: 000000000000000000000000000000"
tests:
  sample.zbus.dyn_channl_build:
    tags: zbus
    build_only: true
    platform_allow: hifive1_revb nrf52840dk_nrf52840 
  sample.zbus.dyn_channel:
    tags: zbus
    platform_allow: native_posix 
```

## prj.conf
```kconfig
CONFIG_LOG=n
CONFIG_ASSERT=y
CONFIG_HEAP_MEM_POOL_SIZE=1024

CONFIG_ZBUS=y
CONFIG_ZBUS_LOG=n
CONFIG_ZBUS_LOG_LEVEL_DBG=n
```

## src/main.c
```c
/*
 * Copyright (c) 2022 Citrinio
 *
 * SPDX-License-Identifier: Apache-2.0
 */

#include <stdint.h>
#include "kernel.h"
#include "zbus.h"

#include <logging/log.h>
LOG_MODULE_DECLARE(zbus, CONFIG_ZBUS_LOG_LEVEL);

/*! benchmark description
 * data variation from 1 to 256 bytes (1,2,4,8,16,32,64,128,256)
 * callback based first
 */

struct pkt {
    struct {
        uint8_t filter : 1;
        uint8_t body_size : 4;

    } header;
    uint8_t body[];
};

void filter_cb(zbus_chan_idx_t idx);
ZBUS_LISTENER_DECLARE(filter, filter_cb);

union zbus_msg_var msg_received = {0};
void filter_cb(zbus_chan_idx_t idx)
{
    struct external_data_msg *chan_message = NULL;
    __ASSERT_NO_MSG(idx == pkt_channel_chan_idx);
    if (!zbus_chan_claim(ZBUS_CHAN_GET(pkt_channel), K_NO_WAIT)) {
        chan_message = (struct external_data_msg *) ZBUS_CHAN_GET(pkt_channel)->message;
        struct pkt *filtered_data = (struct pkt *) chan_message->reference;
        if (filtered_data->header.filter) {
            memset(filtered_data->body, 0, filtered_data->header.body_size);
        }
        zbus_chan_finish(ZBUS_CHAN_GET(pkt_channel));
    }
    struct ack_msg dr = {1};
    ZBUS_CHAN_PUB(data_ready, dr, K_NO_WAIT);
}

void main(void)
{
    struct version_msg v = {0};
    ZBUS_CHAN_READ(version, v, K_NO_WAIT);

    printk("\n -> Sample dynamic filter version %u.%u-%u\n\n", v.major, v.minor, v.build);
}

ZBUS_SUBSCRIBER_DECLARE(producer, 4);
void producer_thread(void)
{
    struct pkt *msg     = NULL;
    zbus_chan_idx_t idx = ZBUS_CHAN_COUNT;

    int i = 0;
    do {
        msg = k_malloc(i + 1);
        __ASSERT_NO_MSG(msg != NULL);
        memset(&msg->body, i, i);
        msg->header.body_size                = i;
        msg->header.filter                   = i % 2;
        struct external_data_msg malloc_data = {.reference = msg,
                                                .size      = sizeof(struct pkt) + i};
        ZBUS_CHAN_PUB(pkt_channel, malloc_data, K_NO_WAIT);
        ++i;
    } while ((i < 16) && !k_msgq_get(producer.queue, &idx, K_FOREVER));
}
K_THREAD_DEFINE(producer_thread_id, 1024, producer_thread, NULL, NULL, NULL, 5, 0, 5000);


ZBUS_SUBSCRIBER_DECLARE(consumer, 4);
void consumer_thread(void)
{
    struct external_data_msg *chan_message = NULL;
    zbus_chan_idx_t idx                    = ZBUS_CHAN_COUNT;
    while (!k_msgq_get(consumer.queue, &idx, K_FOREVER)) {
        __ASSERT_NO_MSG(idx == data_ready_chan_idx);
        if (!zbus_chan_claim(ZBUS_CHAN_GET(pkt_channel), K_NO_WAIT)) {
            chan_message =
                (struct external_data_msg *) ZBUS_CHAN_GET(pkt_channel)->message;
            struct pkt *received = (struct pkt *) chan_message->reference;
            printk("Header: filter=%d,body_size=%02d; Body: ", received->header.filter,
                   received->header.body_size);
            for (int i = 0; i < received->header.body_size; ++i) {
                printk("%02X", received->body[i]);
            }
            printk("\n");

            /* Cleanup the dynamic memory after using that */
            k_free(chan_message->reference);
            chan_message->reference = NULL;
            chan_message->size      = 0;
            zbus_chan_finish(ZBUS_CHAN_GET(pkt_channel));
        }
        struct ack_msg a = {1};
        ZBUS_CHAN_PUB(ack, a, K_MSEC(250));
    }
}

K_THREAD_DEFINE(consumer_thread_id, 1024, consumer_thread, NULL, NULL, NULL, 4, 0, 5000);
```

## include/zbus_channels.h
```c
ZBUS_CHAN_DEFINE(
    pkt_channel,              /* Name */
    false,                    /* On changes only */
    false,                    /* Read only */
    struct external_data_msg, /* Message type */
    NULL,                     /* Validator */
    ZBUS_OBSERVERS(filter),   /* observers */
    ZBUS_MSG_INIT(0)          /* Initial value {0} */
)
ZBUS_CHAN_DEFINE(
    version,                                          /* Name */
    false,                                            /* On changes only */
    true,                                             /* Read only */
    struct version_msg,                               /* Message type */
    NULL,                                             /* Validator */
    ZBUS_OBSERVERS_EMPTY,                             /* observers */
    ZBUS_MSG_INIT(.major = 0, .minor = 1, .build = 1) /* Initial value {0} */
)
ZBUS_CHAN_DEFINE(
    data_ready,               /* Name */
    false,                    /* On changes only */
    false,                    /* Read only */
    struct ack_msg,           /* Message type */
    NULL,                     /* Validator */
    ZBUS_OBSERVERS(consumer), /* observers */
    ZBUS_MSG_INIT(0)          /* Initial value {0} */
)
ZBUS_CHAN_DEFINE(
    ack,                      /* Name */
    false,                    /* On changes only */
    false,                    /* Read only */
    struct ack_msg,           /* Message type */
    NULL,                     /* Validator */
    ZBUS_OBSERVERS(producer), /* observers */
    ZBUS_MSG_INIT(0)          /* Initial value {0} */
)
```

## include/zbus_messages.h
```c
#ifndef _ZBUS_MESSAGES_H_
#define _ZBUS_MESSAGES_H_
#include <zephyr.h>

struct version_msg {
    uint8_t major;
    uint8_t minor;
    uint16_t build;
};

struct external_data_msg {
    void *reference;
    size_t size;
};

struct ack_msg {
    uint8_t value;
};

#endif  // _ZBUS_MESSAGES_H_
```
