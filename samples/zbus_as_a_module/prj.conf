## CMakeLists.txt
```
# SPDX-License-Identifier: Apache-2.0

cmake_minimum_required(VERSION 3.13.1)
find_package(Zephyr REQUIRED HINTS $ENV{ZEPHYR_BASE})
project(zbus_as_a_module)

# this will help zephyr to find the zbus_messages ans zbus_channels files 
zephyr_include_directories(
  "${CMAKE_CURRENT_SOURCE_DIR}/include"
)

list(APPEND HEADERS
  "${CMAKE_CURRENT_SOURCE_DIR}/include"
  )
list(
  APPEND SOURCES
  "${CMAKE_CURRENT_SOURCE_DIR}/src/benchmark_thread.c"
  )

include_directories(${HEADERS})
target_sources(app PRIVATE ${SOURCES})
```

## prj.conf
```kconfig
CONFIG_LOG=y
CONFIG_LOG_MODE_MINIMAL=y
CONFIG_ZBUS=y
CONFIG_ZBUS_LOG=n
CONFIG_ZBUS_LOG_LEVEL_ERR=y
CONFIG_ZBUS_ASSERTS=n
```

## include/zbus_channels.h
```c
ZBUS_CHANNEL(version,              /* Name */
             false,                /* On changes only */
             true,                 /* Read only */
             struct version,       /* Message type */
             ZBUS_OBSERVERS_EMPTY, /* observers */
             ZBUS_MSG_INIT(.major = 0, .minor = 1,
                           .build = 1023) /* Initial value major 0, minor 1, build 1023 */
)

ZBUS_CHANNEL(chan_1b,                       /* Name */
             false,                         /* On changes only */
             false,                         /* Read only */
             struct msg_1b,                 /* Message type */
             ZBUS_OBSERVERS(fast_handler1), /* observers */
             ZBUS_MSG_INIT({0})             /* Initial value {0} */
)

ZBUS_CHANNEL(chan_2b,                       /* Name */
             false,                         /* On changes only */
             false,                         /* Read only */
             struct msg_2b,                 /* Message type */
             ZBUS_OBSERVERS(fast_handler1), /* observers */
             ZBUS_MSG_INIT({0})             /* Initial value {0} */
)

ZBUS_CHANNEL(chan_4b,                       /* Name */
             false,                         /* On changes only */
             false,                         /* Read only */
             struct msg_4b,                 /* Message type */
             ZBUS_OBSERVERS(fast_handler1), /* observers */
             ZBUS_MSG_INIT({0})             /* Initial value {0} */
)

ZBUS_CHANNEL(chan_8b,                       /* Name */
             false,                         /* On changes only */
             false,                         /* Read only */
             struct msg_8b,                 /* Message type */
             ZBUS_OBSERVERS(fast_handler1), /* observers */
             ZBUS_MSG_INIT({0})             /* Initial value {0} */
)

ZBUS_CHANNEL(chan_16b,                      /* Name */
             false,                         /* On changes only */
             false,                         /* Read only */
             struct msg_16b,                /* Message type */
             ZBUS_OBSERVERS(fast_handler1), /* observers */
             ZBUS_MSG_INIT({0})             /* Initial value {0} */
)

ZBUS_CHANNEL(chan_32b,                      /* Name */
             false,                         /* On changes only */
             false,                         /* Read only */
             struct msg_32b,                /* Message type */
             ZBUS_OBSERVERS(fast_handler1), /* observers */
             ZBUS_MSG_INIT({0})             /* Initial value {0} */
)

ZBUS_CHANNEL(chan_64b,                      /* Name */
             false,                         /* On changes only */
             false,                         /* Read only */
             struct msg_64b,                /* Message type */
             ZBUS_OBSERVERS(fast_handler1), /* observers */
             ZBUS_MSG_INIT({0})             /* Initial value {0} */
)

ZBUS_CHANNEL(chan_128b,                     /* Name */
             false,                         /* On changes only */
             false,                         /* Read only */
             struct msg_128b,               /* Message type */
             ZBUS_OBSERVERS(fast_handler1), /* observers */
             ZBUS_MSG_INIT({0})             /* Initial value {0} */
)

ZBUS_CHANNEL(chan_256b,                     /* Name */
             false,                         /* On changes only */
             false,                         /* Read only */
             struct msg_256b,               /* Message type */
             ZBUS_OBSERVERS(fast_handler1), /* observers */
             ZBUS_MSG_INIT({0})             /* Initial value {0} */
)
```

## src/benchmark_thread.c
```c
/*
 * Copyright (c) 2022 Citrinio
 *
 * SPDX-License-Identifier: Apache-2.0
 */

#include <stdint.h>
#include "kernel.h"
#include "sys/util_macro.h"
#include "zbus.h"

#include <logging/log.h>
#include "zbus.h"
#include "zbus_messages.h"
LOG_MODULE_DECLARE(zbus, CONFIG_ZBUS_LOG_LEVEL);

/*! benchmark description
 * data variation from 1 to 256 bytes (1,2,4,8,16,32,64,128,256)
 * callback based first
 */
#define BYTES_TO_BE_SENT (256LLU * 1000)
void fh1_cb(zbus_channel_index_t idx);


ZBUS_SUBSCRIBER_DECLARE(fast_handler1, 16);


zbus_channel_index_t current_idx = chan_256b_index;
size_t current_message_size      = 0;

uint64_t count                      = 0;
zbus_message_variant_t msg_received = {0};
void thread_handler1_task()
{
    zbus_channel_index_t idx = ZBUS_CHANNEL_COUNT;
    while (!k_msgq_get(fast_handler1.queue, &idx, K_FOREVER)) {
        if (!ZBUS_CHAN_READ_BY_INDEX(idx, msg_received, K_NO_WAIT)) {
            count += current_message_size;
        }
    }
}

K_THREAD_DEFINE(thread_handler1_id, 1024, thread_handler1_task, NULL, NULL, NULL, 3, 0,
                0);

void main(void)
{
    struct version v = {0};
    ZBUS_CHAN_READ(version, v, K_NO_WAIT);

    LOG_DBG("Benchmark sample started, version %u.%u-%u!", v.major, v.minor, v.build);
}

void producer_thread(void)
{
    zbus_message_variant_t msg_sent = {0};
    for (uint8_t i = 255; i > 0; --i) {
        msg_sent.chan_256b.bytes[i] = i;
    }
    current_message_size = zbus_chan_get_by_index(current_idx)->message_size;
    uint32_t start       = k_uptime_get_32();
    for (uint64_t internal_count = BYTES_TO_BE_SENT; internal_count > 0;
         internal_count -= current_message_size) {
        ZBUS_CHAN_PUB_BY_INDEX(current_idx, msg_sent, K_MSEC(250));
    }
    uint32_t duration = (k_uptime_get_32() - start);
    uint64_t i        = (BYTES_TO_BE_SENT * 1000LLU) / duration;
    uint64_t f        = ((BYTES_TO_BE_SENT * 100000LLU) / duration) % 100;
    printk("\n *** Bytes sent = %lld, received = %llu in %ums\n     Average data rate: "
           "%llu.%lluB/s\n\n\n",
           BYTES_TO_BE_SENT, count, duration, i, f);
}

K_THREAD_DEFINE(producer_thread_id, 1024, producer_thread, NULL, NULL, NULL, 5, 0, 10);
```
