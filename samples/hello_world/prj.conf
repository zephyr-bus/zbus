## CMakeLists.txt
```
# SPDX-License-Identifier: Apache-2.0

cmake_minimum_required(VERSION 3.13.1)
find_package(Zephyr REQUIRED HINTS $ENV{ZEPHYR_BASE})
project(zbus_as_a_module)

# this will help zephyr to find the zbus_messages ans zbus_channels files 
zephyr_include_directories(
  "${CMAKE_CURRENT_SOURCE_DIR}/include"
)

list(APPEND HEADERS
  "${CMAKE_CURRENT_SOURCE_DIR}/include"
  )
list(
  APPEND SOURCES
  "${CMAKE_CURRENT_SOURCE_DIR}/src/main.c"
  )

include_directories(${HEADERS})
target_sources(app PRIVATE ${SOURCES})
```

## sample.yaml
```
sample:
  name: Hello World
common:
  tags: zbus
  timeout: 2
  harness: console
  harness_config:
    type: multi_line
    ordered: true
    regex:
     - "D: Sensor sample started raw reading, version 0.1-2!"
     - "D: Sensor sample started macro reading, version 0.1-2!"
     - "D: From listener -> Acc x=1, y=1, z=1"
     - "D: From subscriber -> Acc x=1, y=1, z=1"
     - "D: From listener -> Acc x=2, y=2, z=2"
     - "D: From subscriber -> Acc x=2, y=2, z=2"
tests:
  sample.zbus.hello_world_build:
    tags: zbus
    build_only: true
    platform_allow: hifive1_revb nrf52840dk_nrf52840 
  sample.zbus.hello_world:
    tags: zbus
    platform_allow: native_posix 
```

## prj.conf
```kconfig
CONFIG_LOG=y
CONFIG_LOG_MODE_MINIMAL=y
CONFIG_ZBUS=y
CONFIG_ZBUS_LOG=y
CONFIG_ZBUS_LOG_LEVEL_DBG=y

CONFIG_MAIN_THREAD_PRIORITY=5
```

## src/main.c
```c
/*
 * Copyright (c) 2022 Citrinio
 *
 * SPDX-License-Identifier: Apache-2.0
 */

#include <stdint.h>
#include "kernel.h"
#include "zbus.h"
#include "zbus_messages.h"

#include <logging/log.h>
LOG_MODULE_DECLARE(zbus, CONFIG_ZBUS_LOG_LEVEL);

void listener_callback_example(zbus_chan_idx_t idx);
ZBUS_LISTENER_DECLARE(my_listener, listener_callback_example);

void listener_callback_example(zbus_chan_idx_t idx)
{
    struct acc_msg acc = {0};
    ZBUS_CHAN_READ_BY_INDEX(idx, acc, K_NO_WAIT);
    LOG_DBG("From listener -> Acc x=%d, y=%d, z=%d", acc.x, acc.y, acc.z);
}

ZBUS_SUBSCRIBER_DECLARE(my_subscriber, 4);
void subscriber_task()
{
    zbus_chan_idx_t idx;
    while (!k_msgq_get(my_subscriber.queue, &idx, K_FOREVER)) {
        struct acc_msg acc = {0};
        if (acc_data_chan_idx == idx) {
            ZBUS_CHAN_READ(acc_data, acc, K_NO_WAIT);
            LOG_DBG("From subscriber -> Acc x=%d, y=%d, z=%d", acc.x, acc.y, acc.z);
        }
    }
}
K_THREAD_DEFINE(subscriber_task_id, 512, subscriber_task, NULL, NULL, NULL, 3, 0, 0);


/* Do not use main thread to publish messages. It may generate an inconsistent behavior.
 * The default priority of main thread is the same as zbus event dispatcher. It can cause
 * a undesired zbus preemptions.
 *
 * To fix that you can change the main thread priority as we are doing here in this
 * example or use another thread with less priority. We suggest to use threads priority
 * from 3 and on.
 *
 * You always give the producer less priority than the consumer. It will guarantee the
 * expected behavior to happen.
 */
void main(void)
{
    /* The raw way to reading a channel's message */
    struct version v = {0};
    zbus_chan_read(ZBUS_CHAN_GET(version), (uint8_t*) &v, sizeof(v), K_NO_WAIT);
    LOG_DBG("Sensor sample started raw reading, version %u.%u-%u!", v.major, v.minor,
            v.build);

    /* The macro way to reading a channel's message */
    struct version v2 = {0};
    ZBUS_CHAN_READ(version, v2, K_NO_WAIT);
    LOG_DBG("Sensor sample started macro reading, version %u.%u-%u!", v2.major, v2.minor,
            v2.build);

    /* The raw way to publishing a channel's message */
    struct acc_msg acc1 = {.x = 1, .y = 1, .z = 1};
    zbus_chan_pub(ZBUS_CHAN_GET(acc_data), (uint8_t*) &acc1, sizeof(acc1), K_SECONDS(1));

    /* The macro way to publishing a channel's message */
    struct acc_msg acc2 = {.x = 2, .y = 2, .z = 2};
    ZBUS_CHAN_PUB(acc_data, acc2, K_MSEC(1000));
}
```

## include/zbus_channels.h
```c
ZBUS_CHAN_DEFINE(
    version,              /* Name */
    false,                /* On changes only */
    true,                 /* Read only */
    struct version,       /* Message type */
    NULL,                 /* Validator */
    ZBUS_OBSERVERS_EMPTY, /* observers */
    ZBUS_MSG_INIT(.major = 0, .minor = 1,
                  .build = 2) /* Initial value major 0, minor 1, build 1023 */
)
ZBUS_CHAN_DEFINE(
    acc_data,                                   /* Name */
    false,                                      /* On changes only */
    false,                                      /* Read only */
    struct acc_msg,                             /* Message type */
    NULL,                                       /* Validator */
    ZBUS_OBSERVERS(my_listener, my_subscriber), /* observers */
    ZBUS_MSG_INIT(.x = 0, .y = 0, .z = 0)       /* Initial value {0} */
)
```

## include/zbus_messages.h
```c
#ifndef _ZBUS_MESSAGES_H_
#define _ZBUS_MESSAGES_H_
#include <zephyr.h>

struct version {
    uint8_t major;
    uint8_t minor;
    uint16_t build;
};

struct acc_msg {
    int x;
    int y;
    int z;
};


#endif  // _ZBUS_MESSAGES_H_
```
