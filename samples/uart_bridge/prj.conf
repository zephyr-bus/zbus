## CMakeLists.txt
```
# SPDX-License-Identifier: Apache-2.0

cmake_minimum_required(VERSION 3.13.1)
find_package(Zephyr REQUIRED HINTS $ENV{ZEPHYR_BASE})
project(integration)

# this will help zephyr to find the zbus_messages ans zbus_channels files 
zephyr_include_directories(
  "${CMAKE_CURRENT_SOURCE_DIR}/include"
)

list(APPEND HEADERS
  "${CMAKE_CURRENT_SOURCE_DIR}/include"
  )
list(
  APPEND SOURCES
  "${CMAKE_CURRENT_SOURCE_DIR}/src/core.c"
  "${CMAKE_CURRENT_SOURCE_DIR}/src/bridge.c"
  "${CMAKE_CURRENT_SOURCE_DIR}/src/ct_uart.c"
  "${CMAKE_CURRENT_SOURCE_DIR}/src/main.c"
  "${CMAKE_CURRENT_SOURCE_DIR}/src/peripheral.c"
  )

include_directories(${HEADERS})
target_sources(app PRIVATE ${SOURCES})
```

## sample.yaml
```
sample:
  name: UART bridge
common:
  tags: zbus
  timeout: 10
  harness: console
  harness_config:
    type: multi_line
    ordered: true
    regex:
     - "D: [Bridge] Started."
     - "D: [Bridge] send data 0"
     - "D: [Bridge] send data 0"
     - "D: [Core] sending start measurement with status 1"
     - "D: [ZBUS] pub start_measurement at WEST_TOPDIR/zbus/samples/uart_bridge/src/core.c:24"
     - "D: [ZBUS] notify!"
     - "D: [Bridge] send data 0"
     - "D: [Peripheral] sending sensor data"
     - "D: [ZBUS] pub sensor_data at WEST_TOPDIR/zbus/samples/uart_bridge/src/peripheral.c:26"
     - "D: [ZBUS] notify!"
tests:
  sample.zbus.uart_bridge_build:
    tags: zbus
    build_only: true
    platform_allow: native_posix hifive1_revb nrf52840dk_nrf52840 
```

## prj.conf
```kconfig
CONFIG_LOG=y
CONFIG_LOG_MODE_MINIMAL=y
CONFIG_SERIAL=y
CONFIG_UART_INTERRUPT_DRIVEN=y
CONFIG_UART_LINE_CTRL=n
CONFIG_UART_SIFIVE_PORT_1=y
CONFIG_UART_SIFIVE_PORT_1_TXCNT_IRQ=1
CONFIG_UART_SIFIVE_PORT_1_RXCNT_IRQ=1
CONFIG_ZBUS_EXT=y
CONFIG_ZBUS_LOG=y
CONFIG_ZBUS_LOG_LEVEL_DBG=y
```

## prj_hifive1_revb.conf
```kconfig
CONFIG_LOG=y
CONFIG_LOG_MODE_MINIMAL=y
CONFIG_SERIAL=y
CONFIG_UART_INTERRUPT_DRIVEN=y
CONFIG_UART_LINE_CTRL=n
CONFIG_UART_SIFIVE_PORT_1=y
CONFIG_UART_SIFIVE_PORT_1_TXCNT_IRQ=1
CONFIG_UART_SIFIVE_PORT_1_RXCNT_IRQ=1
CONFIG_ZBUS=y
CONFIG_ZBUS_LOG=y
CONFIG_ZBUS_LOG_LEVEL_DBG=y
CONFIG_ZBUS_CHANNEL_USER_DATA=y
CONFIG_ZBUS_CHANNEL_USER_DATA_SIZE=1
```

## prj_native_posix.conf
```kconfig
CONFIG_LOG=y
CONFIG_LOG_MODE_MINIMAL=y
CONFIG_SERIAL=y
#CONFIG_UART_INTERRUPT_DRIVEN=y
CONFIG_UART_LINE_CTRL=n
CONFIG_ZBUS=y
CONFIG_ZBUS_LOG=y
CONFIG_ZBUS_LOG_LEVEL_DBG=y
CONFIG_ZBUS_CHANNEL_USER_DATA=y
CONFIG_ZBUS_CHANNEL_USER_DATA_SIZE=1
```

## prj_nrf52840dk_nrf52840.conf
```kconfig
CONFIG_LOG=y
CONFIG_LOG_MODE_MINIMAL=y
CONFIG_SERIAL=y
#CONFIG_UART_INTERRUPT_DRIVEN=y
CONFIG_UART_LINE_CTRL=n
CONFIG_ZBUS=y
CONFIG_ZBUS_LOG=y
CONFIG_ZBUS_LOG_LEVEL_DBG=y
CONFIG_ZBUS_CHANNEL_USER_DATA=y
CONFIG_ZBUS_CHANNEL_USER_DATA_SIZE=1
CONFIG_UART_NATIVE_POSIX=y
```

## native_posix.overlay
```dts
/*
 * RS232 usart
 */
/ {
    aliases {
            bridge-serial = &uart0;
    };

};
```

## nrf52840dk_nrf52840.overlay
```dts
/*
 * RS232 usart
 */
/ {
    aliases {
            bridge-serial = &uart1;
    };

};
&uart1 {
	status = "okay";
    current-speed = <115200>;
    clock-frequency = <16000000>;
};
```

## src/main.c
```c
/*
 * Copyright (c) 2022 Citrinio
 *
 * SPDX-License-Identifier: Apache-2.0
 */

#include <stdint.h>
#include "kernel.h"
#include "sys/util_macro.h"
#include "zbus.h"

#include <logging/log.h>
LOG_MODULE_DECLARE(zbus, CONFIG_ZBUS_LOG_LEVEL);


void main(void)
{
    LOG_DBG("MAIN Started!");
}
```

## include/ct_uart.h
```c
#pragma once
#include <device.h>
#include <inttypes.h>
#include <kernel.h>
#include <zephyr.h>

struct ct_uart_device {
    const struct device *dev;
    struct k_msgq *input_msgq;
    struct k_msgq *output_msgq;
    bool ready;
};

int ct_uart_open(struct ct_uart_device *uart);

int ct_uart_write(struct ct_uart_device *uart, uint8_t *data, size_t size);

int ct_uart_write_str(struct ct_uart_device *uart, char *str);

int ct_uart_write_byte(struct ct_uart_device *uart, uint8_t *byte);
```

## include/zbus_channels.h
```c
ZBUS_CHAN_DEFINE(
    version,              /* Name */
    false,                /* On changes only */
    true,                 /* Read only */
    struct version,       /* Message type */
    NULL,                 /* Validator */
    ZBUS_OBSERVERS_EMPTY, /* observers */
    ZBUS_MSG_INIT(.major = 0, .minor = 1,
                  .build = 1023) /* Initial value major 0, minor 1, build 1023 */
)
ZBUS_CHAN_DEFINE(
    sensor_data,          /* Name */
    true,                 /* On changes only */
    false,                /* Read only */
    struct sensor_data,   /* Message type */
    NULL,                 /* Validator */
    ZBUS_OBSERVERS(bridge), /* observers */
    ZBUS_MSG_INIT(0)      /* Initial value {0} */
)
ZBUS_CHAN_DEFINE(
    start_measurement,          /* Name */
    false,                      /* On changes only */
    false,                      /* Read only */
    struct action,              /* Message type */
    NULL,                       /* Validator */
    ZBUS_OBSERVERS(bridge, peripheral), /* observers */
    ZBUS_MSG_INIT(false)        /* Initial value */
)
ZBUS_CHAN_DEFINE(
    finish,               /* Name */
    false,                /* On changes only */
    false,                /* Read only */
    struct action,        /* Message type */
    NULL,                 /* Validator */
    ZBUS_OBSERVERS(bridge), /* observers */
    ZBUS_MSG_INIT(false)  /* Initial value */
)
```

## src/bridge.c
```c
#include <kernel.h>
#include <string.h>
#include <sys/crc.h>
#include <sys/printk.h>
#include <zephyr.h>
#include "ct_uart.h"

#include "zbus.h"

#include <logging/log.h>
LOG_MODULE_DECLARE(zbus, CONFIG_ZBUS_LOG_LEVEL);

K_MSGQ_DEFINE(_bridge_input_msgq, sizeof(uint8_t), 256, 1);
K_MSGQ_DEFINE(_bridge_output_msgq, sizeof(uint8_t), 256, 1);

ZBUS_SUBSCRIBER_DECLARE(bridge, 4);

struct ct_uart_device bridge_uart = {DEVICE_DT_GET(DT_ALIAS(bridge_serial)),
                                     &_bridge_input_msgq, &_bridge_output_msgq};
void bridge_tx_thread(void)
{
    zbus_chan_idx_t idx         = 0;
    union zbus_msg_var msg_data = {0};
    uint8_t tokens[]            = "$\r\n";

    if (ct_uart_open(&bridge_uart)) {
        return;
    }
    zbus_info_dump();
    ct_uart_write_str(&bridge_uart, "Hello world!\n");
    LOG_DBG("[Bridge] Started.");
    while (1) {
        if (!k_msgq_get(bridge.queue, &idx, K_FOREVER)) {
            struct zbus_channel *chan = zbus_chan_get_by_index(idx);
            if (!zbus_chan_claim(chan, K_MSEC(500))) {
                bool generated_by_the_bridge = chan->user_data[0];
                chan->user_data[0] = (uint8_t) false;
                zbus_chan_finish(chan);
                /* true here means the package was published by the bridge and must be
                 * discarded */
                if (!generated_by_the_bridge) {
                    LOG_DBG("[Bridge] send data %d",
                            zbus_chan_read(chan, (uint8_t *) &msg_data, chan->message_size,
                                           K_MSEC(500)));
                    ct_uart_write_byte(&bridge_uart, tokens);
                    ct_uart_write_byte(&bridge_uart, (uint8_t *) &idx);
                    ct_uart_write(&bridge_uart, (uint8_t *) &msg_data, chan->message_size);
                    ct_uart_write(&bridge_uart, tokens + 1, 2);
                }
            }
        }
    }
}
K_THREAD_DEFINE(bridge_thread_tid, 2048, bridge_tx_thread, NULL, NULL, NULL, 1, 0, 500);
```

## src/core.c
```c
/**
 * @file      core.c
 * @brief     Header of
 * @date      Sun Nov 28 18:03:41 2021
 * @author    Rodrigo Peixoto
 * @copyright MIT
 *
 * This module
 */

#include "zbus.h"

#include <logging/log.h>
LOG_MODULE_DECLARE(zbus, CONFIG_ZBUS_LOG_LEVEL);

K_MSGQ_DEFINE(core_queue, sizeof(zbus_chan_idx_t), 10, sizeof(zbus_chan_idx_t));

void core_thread(void)
{
    struct action start = {false};
    while (1) {
        LOG_DBG("[Core] sending start measurement with status %d", start.status);
        start.status = !start.status;
        ZBUS_CHAN_PUB(start_measurement, start, K_MSEC(500));
        k_msleep(1000);
    }
}

K_THREAD_DEFINE(core_thread_id, 1024, core_thread, NULL, NULL, NULL, 3, 0, 0);
```

## src/ct_uart.c
```c
#include "ct_uart.h"
#include <drivers/uart.h>

#include <logging/log.h>
LOG_MODULE_DECLARE(zbus, CONFIG_ZBUS_LOG_LEVEL);

static void uart_fifo_callback(const struct device *dev, void *user_data)
{
    struct ct_uart_device *uart = (struct ct_uart_device *) user_data;
    uint8_t data                = 0;
    if (!uart_irq_update(dev)) {
        LOG_ERR("It should be 1!");
        return;
    }

    if (uart_irq_tx_ready(dev)) {
        if (!k_msgq_get(uart->output_msgq, &data, K_NO_WAIT)) {
            uart_fifo_fill(dev, &data, sizeof(uint8_t));
        } else {
            uart_irq_tx_disable(dev);
        }
    }

    data = 0;

    if (uart_irq_rx_ready(dev)) {
        uart_fifo_read(dev, &data, sizeof(uint8_t));
        k_msgq_put(uart->input_msgq, &data, K_NO_WAIT);
    }
}

int ct_uart_open(struct ct_uart_device *uart)
{
    if (!device_is_ready(uart->dev)) {
        /* Not ready, do not use */
        return -ENODEV;
    }

    if (uart == NULL) {
        LOG_ERR("The UART device was not found.");
        return -EINVAL;
    }
    uart_irq_callback_user_data_set(uart->dev, uart_fifo_callback, uart);
    uart_irq_rx_enable(uart->dev);

    uart->ready = true;
    return 0;
}

int ct_uart_write(struct ct_uart_device *uart, uint8_t *data, size_t size)
{
    if (uart == NULL || uart->dev == NULL || uart->ready == false) {
        return -ENODEV;
    }
    int err            = 0;
    uint8_t *data_end  = data + size;
    uint8_t *data_iter = data;
    for (; data_iter < data_end; ++data_iter) {
        err = err || k_msgq_put(uart->output_msgq, data_iter, K_MSEC(10));
    }

    uart_irq_tx_enable(uart->dev);

    return err;
}

int ct_uart_write_str(struct ct_uart_device *uart, char *str)
{
    if (uart == NULL || uart->dev == NULL || uart->ready == false) {
        return -ENODEV;
    }
    int err         = 0;
    char *data_iter = str;
    for (; *data_iter != '\0'; ++data_iter) {
        err = err || k_msgq_put(uart->output_msgq, data_iter, K_MSEC(10));
    }

    uart_irq_tx_enable(uart->dev);

    return err;
}

int ct_uart_write_byte(struct ct_uart_device *uart, uint8_t *byte)
{
    if (uart == NULL || uart->dev == NULL) {
        return -ENODEV;
    }
    int err = k_msgq_put(uart->output_msgq, byte, K_MSEC(10));
    if (!err) {
        uart_irq_tx_enable(uart->dev);
    }
    return err;
}
```

## src/peripheral.c
```c
/**
 * @file      peripheral.c
 * @brief     Header of
 * @date      Mon Nov 29 16:54:38 2021
 * @author    Rodrigo Peixoto
 * SPDX-License-Identifier: Apache-2.0
 *
 * This module
 */


#include <logging/log.h>
#include "zbus.h"
LOG_MODULE_DECLARE(zbus, CONFIG_ZBUS_LOG_LEVEL);

ZBUS_SUBSCRIBER_DECLARE(peripheral, 8);

void peripheral_thread(void)
{
    struct sensor_data sd  = {0, 0};
    zbus_chan_idx_t idx = 0;
    while (!k_msgq_get(peripheral.queue, &idx, K_FOREVER)) {
        sd.a += 1;
        sd.b += 10;
        LOG_DBG("[Peripheral] sending sensor data");
        ZBUS_CHAN_PUB(sensor_data, sd, K_MSEC(250));
    }
}

K_THREAD_DEFINE(peripheral_thread_id, 1024, peripheral_thread, NULL, NULL, NULL, 3, 0, 0);
```
