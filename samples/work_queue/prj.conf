## CMakeLists.txt
```
# SPDX-License-Identifier: Apache-2.0

cmake_minimum_required(VERSION 3.13.1)
find_package(Zephyr REQUIRED HINTS $ENV{ZEPHYR_BASE})
project(work_queue)

# this will help zephyr to find the zbus_messages ans zbus_channels files 
zephyr_include_directories(
  "${CMAKE_CURRENT_SOURCE_DIR}/include"
)

list(APPEND HEADERS
  "${CMAKE_CURRENT_SOURCE_DIR}/include"
  )
list(
  APPEND SOURCES
  "${CMAKE_CURRENT_SOURCE_DIR}/src/main.c"
  "${CMAKE_CURRENT_SOURCE_DIR}/src/sensors.c"
  )

include_directories(${HEADERS})
target_sources(app PRIVATE ${SOURCES})
```

## sample.yaml
```
sample:
  name: Work queue
common:
  tags: zbus
  timeout: 2
  harness: console
  harness_config:
    type: multi_line
    ordered: true
    regex:
     - "D: Sensor sample started, version 0.1-1023!"
     - "Sensor msg processed by CALLBACK fh1: temp = 10, press = 1, humidity = 100"
     - "Sensor msg processed by CALLBACK fh2: temp = 10, press = 1, humidity = 100"
     - "Sensor msg processed by CALLBACK fh3: temp = 10, press = 1, humidity = 100"
     - "Sensor msg processed by WORK QUEUE handler dh1: temp = 10, press = 1, humidity = 100"
     - "Sensor msg processed by WORK QUEUE handler dh2: temp = 10, press = 1, humidity = 100"
     - "Sensor msg processed by WORK QUEUE handler dh3: temp = 10, press = 1, humidity = 100"
     - "Sensor msg processed by THREAD handler: temp = 10, press = 1, humidity = 100"
     - "Sensor msg processed by THREAD handler: temp = 10, press = 1, humidity = 100"
     - "Sensor msg processed by THREAD handler: temp = 10, press = 1, humidity = 100"
     - "Sensor msg processed by CALLBACK fh1: temp = 20, press = 2, humidity = 200"
     - "Sensor msg processed by CALLBACK fh2: temp = 20, press = 2, humidity = 200"
     - "Sensor msg processed by CALLBACK fh3: temp = 20, press = 2, humidity = 200"
     - "Sensor msg processed by WORK QUEUE handler dh1: temp = 20, press = 2, humidity = 200"
     - "Sensor msg processed by WORK QUEUE handler dh2: temp = 20, press = 2, humidity = 200"
     - "Sensor msg processed by WORK QUEUE handler dh3: temp = 20, press = 2, humidity = 200"
     - "Sensor msg processed by THREAD handler: temp = 20, press = 2, humidity = 200"
     - "Sensor msg processed by THREAD handler: temp = 20, press = 2, humidity = 200"
     - "Sensor msg processed by THREAD handler: temp = 20, press = 2, humidity = 200"

tests:
  sample.zbus.work_queue_build:
    tags: zbus
    build_only: true
    platform_allow: hifive1_revb nrf52840dk_nrf52840 
  sample.zbus.work_queue:
    tags: zbus
    platform_allow: native_posix 
```

## prj.conf
```kconfig
CONFIG_LOG=y
CONFIG_LOG_MODE_MINIMAL=y
CONFIG_ZBUS=y
CONFIG_ZBUS_LOG=y
CONFIG_ZBUS_LOG_LEVEL_DBG=y
```

## src/main.c
```c
/*
 * Copyright (c) 2016 Intel Corporation
 *
 * SPDX-License-Identifier: Apache-2.0
 */

#include <stdint.h>
#include "kernel.h"
#include "sys/util_macro.h"
#include "zbus.h"

#include <logging/log.h>
#include "zbus.h"
#include "zbus_messages.h"
LOG_MODULE_DECLARE(zbus, CONFIG_ZBUS_LOG_LEVEL);

void fh1_cb(zbus_chan_idx_t idx);
ZBUS_LISTENER_DECLARE(fast_handler1, fh1_cb);

void fh2_cb(zbus_chan_idx_t idx);
ZBUS_LISTENER_DECLARE(fast_handler2, fh2_cb);

void fh3_cb(zbus_chan_idx_t idx);
ZBUS_LISTENER_DECLARE(fast_handler3, fh3_cb);

void dh1_cb(zbus_chan_idx_t idx);
ZBUS_LISTENER_DECLARE(delay_handler1, dh1_cb);

void dh2_cb(zbus_chan_idx_t idx);
ZBUS_LISTENER_DECLARE(delay_handler2, dh2_cb);

void dh3_cb(zbus_chan_idx_t idx);
ZBUS_LISTENER_DECLARE(delay_handler3, dh3_cb);

struct sensor_msg msg = {0};
void fh1_cb(zbus_chan_idx_t idx)
{
    ZBUS_CHAN_READ_BY_INDEX(idx, msg, K_NO_WAIT);
    printk("Sensor msg processed by CALLBACK fh1: temp = %u, press = %u, humidity = %u\n",
           msg.temp, msg.press, msg.humidity);
}
void fh2_cb(zbus_chan_idx_t idx)
{
    ZBUS_CHAN_READ_BY_INDEX(idx, msg, K_NO_WAIT);
    printk("Sensor msg processed by CALLBACK fh2: temp = %u, press = %u, humidity = %u\n",
           msg.temp, msg.press, msg.humidity);
}
void fh3_cb(zbus_chan_idx_t idx)
{
    ZBUS_CHAN_READ_BY_INDEX(idx, msg, K_NO_WAIT);
    printk("Sensor msg processed by CALLBACK fh3: temp = %u, press = %u, humidity = %u\n",
           msg.temp, msg.press, msg.humidity);
}


struct sensor_wq_info {
    struct k_work work;
    zbus_chan_idx_t idx;
    uint8_t handle;
};

struct sensor_wq_info wq_handler1 = {.handle = 1};
struct sensor_wq_info wq_handler2 = {.handle = 2};
struct sensor_wq_info wq_handler3 = {.handle = 3};

void wq_dh_cb(struct k_work *item)
{
    struct sensor_wq_info *sens = CONTAINER_OF(item, struct sensor_wq_info, work);
    ZBUS_CHAN_READ_BY_INDEX(sens->idx, msg, K_NO_WAIT);
    printk("Sensor msg processed by WORK QUEUE handler dh%u: temp = %u, press = %u, "
           "humidity = %u\n",
           sens->handle, msg.temp, msg.press, msg.humidity);
}

void dh1_cb(zbus_chan_idx_t idx)
{
    wq_handler1.idx = idx;
    k_work_submit(&wq_handler1.work);
}

void dh2_cb(zbus_chan_idx_t idx)
{
    wq_handler2.idx = idx;
    k_work_submit(&wq_handler2.work);
}

void dh3_cb(zbus_chan_idx_t idx)
{
    wq_handler3.idx = idx;
    k_work_submit(&wq_handler3.work);
}

void main(void)
{
    k_work_init(&wq_handler1.work, wq_dh_cb);
    k_work_init(&wq_handler2.work, wq_dh_cb);
    k_work_init(&wq_handler3.work, wq_dh_cb);

    struct version v = {0};
    ZBUS_CHAN_READ(version, v, K_NO_WAIT);

    LOG_DBG("Sensor sample started, version %u.%u-%u!", v.major, v.minor, v.build);
}

ZBUS_SUBSCRIBER_DECLARE(thread_handler1, 4);
void thread_handler1_task()
{
    zbus_chan_idx_t idx = ZBUS_CHAN_COUNT;
    while (!k_msgq_get(thread_handler1.queue, &idx, K_FOREVER)) {
        ZBUS_CHAN_READ_BY_INDEX(idx, msg, K_NO_WAIT);
        printk("Sensor msg processed by THREAD handler: temp = %u, press = %u, "
               "humidity = %u\n",
               msg.temp, msg.press, msg.humidity);
    }
}

K_THREAD_DEFINE(thread_handler1_id, 1024, thread_handler1_task, NULL, NULL, NULL, 3, 0,
                0);

ZBUS_SUBSCRIBER_DECLARE(thread_handler2, 4);
void thread_handler2_task()
{
    zbus_chan_idx_t idx = ZBUS_CHAN_COUNT;
    while (!k_msgq_get(thread_handler2.queue, &idx, K_FOREVER)) {
        ZBUS_CHAN_READ_BY_INDEX(idx, msg, K_NO_WAIT);
        printk("Sensor msg processed by THREAD handler: temp = %u, press = %u, "
               "humidity = %u\n",
               msg.temp, msg.press, msg.humidity);
    }
}

K_THREAD_DEFINE(thread_handler2_id, 1024, thread_handler2_task, NULL, NULL, NULL, 3, 0,
                0);

ZBUS_SUBSCRIBER_DECLARE(thread_handler3, 4);
void thread_handler3_task()
{
    zbus_chan_idx_t idx = ZBUS_CHAN_COUNT;
    while (!k_msgq_get(thread_handler3.queue, &idx, K_FOREVER)) {
        ZBUS_CHAN_READ_BY_INDEX(idx, msg, K_NO_WAIT);
        printk("Sensor msg processed by THREAD handler: temp = %u, press = %u, "
               "humidity = %u\n",
               msg.temp, msg.press, msg.humidity);
    }
}

K_THREAD_DEFINE(thread_handler3_id, 1024, thread_handler3_task, NULL, NULL, NULL, 3, 0,
                0);
```

## include/zbus_channels.h
```c
ZBUS_CHAN_DEFINE(
    version,              /* Name */
    false,                /* On changes only */
    true,                 /* Read only */
    struct version,       /* Message type */
    NULL,                 /* Validator */
    ZBUS_OBSERVERS_EMPTY, /* observers */
    ZBUS_MSG_INIT(.major = 0, .minor = 1,
                  .build = 1023) /* Initial value major 0, minor 1, build 1023 */
)
ZBUS_CHAN_DEFINE(
    sensor_data,       /* Name */
    false,             /* On changes only */
    false,             /* Read only */
    struct sensor_msg, /* Message type */
    NULL,              /* Validator */
    ZBUS_OBSERVERS(fast_handler1, fast_handler2, fast_handler3,
                   delay_handler1, delay_handler2, delay_handler3,
                   thread_handler1, thread_handler2,
                   thread_handler3), /* observers */
    ZBUS_MSG_INIT(0)                 /* Initial value {0} */
)
```

## include/zbus_messages.h
```c
#ifndef _ZBUS_MESSAGES_H_
#define _ZBUS_MESSAGES_H_
#include <zephyr.h>

struct version {
    uint8_t major;
    uint8_t minor;
    uint16_t build;
};

struct sensor_msg {
    uint32_t temp;
    uint32_t press;
    uint32_t humidity;
};

#endif  // _ZBUS_MESSAGES_H_
```

## src/sensors.c
```c
/**
 * @file      peripheral.c
 * @brief     Header of
 * @date      Mon Nov 29 16:54:38 2021
 * @author    Rodrigo Peixoto
 * SPDX-License-Identifier: Apache-2.0
 *
 * This module
 */


#include <logging/log.h>
#include "zbus.h"
LOG_MODULE_DECLARE(zbus, CONFIG_ZBUS_LOG_LEVEL);

void peripheral_thread(void)
{
    struct sensor_msg sm = {0, 0};
    while (1) {
        sm.press += 1;
        sm.temp += 10;
        sm.humidity += 100;
        LOG_DBG("Sending sensor data...");
        ZBUS_CHAN_PUB(sensor_data, sm, K_MSEC(250));
        k_msleep(1000); /* Fix this for the target. */
    }
}

K_THREAD_DEFINE(peripheral_thread_id, 1024, peripheral_thread, NULL, NULL, NULL, 5, 0, 0);
```
