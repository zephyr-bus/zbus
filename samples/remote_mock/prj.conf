## CMakeLists.txt
```
# SPDX-License-Identifier: Apache-2.0

cmake_minimum_required(VERSION 3.13.1)
find_package(Zephyr REQUIRED HINTS $ENV{ZEPHYR_BASE})
project(integration)

# this will help zephyr to find the zbus_messages ans zbus_channels files 
zephyr_include_directories(
  "${CMAKE_CURRENT_SOURCE_DIR}/include"
)

list(APPEND HEADERS
  "${CMAKE_CURRENT_SOURCE_DIR}/include"
  )
list(
  APPEND SOURCES
  "${CMAKE_CURRENT_SOURCE_DIR}/src/mock_proxy.c"
  "${CMAKE_CURRENT_SOURCE_DIR}/src/ct_uart.c"
  "${CMAKE_CURRENT_SOURCE_DIR}/src/peripheral.c"
  )

include_directories(${HEADERS})
target_sources(app PRIVATE ${SOURCES})
```

## sample.yaml
```
sample:
  name: Remote mock
tests:
  sample.zbus.remote_mock:
    build_only: true
    tags: zbus
    platform_allow: hifive1_revb 
```

## prj.conf
```kconfig
CONFIG_LOG=y
CONFIG_LOG_MODE_MINIMAL=n
CONFIG_SERIAL=y
CONFIG_UART_INTERRUPT_DRIVEN=y
CONFIG_UART_LINE_CTRL=n
CONFIG_UART_SIFIVE_PORT_1=y
CONFIG_UART_SIFIVE_PORT_1_TXCNT_IRQ=1
CONFIG_UART_SIFIVE_PORT_1_RXCNT_IRQ=1
CONFIG_NET_BUF=y
CONFIG_NET_BUF_SIMPLE_LOG=y
CONFIG_ZBUS=y
CONFIG_ZBUS_LOG=y
CONFIG_ZBUS_LOG_LEVEL_DBG=y
CONFIG_ZBUS_CHANNEL_USER_DATA=y
CONFIG_ZBUS_CHANNEL_USER_DATA_SIZE=1
```

## hifive1_revb.overlay
```dts
/*
 * RS232 usart
 */

&uart1 {
	status = "okay";
    current-speed = <115200>;
    clock-frequency = <16000000>;
};
```

## include/ct_uart.h
```c
#pragma once
#include <device.h>
#include <inttypes.h>
#include <kernel.h>
#include <zephyr.h>

struct ct_uart_device {
    const struct device *dev;
    struct k_msgq *input_msgq;
    struct k_msgq *output_msgq;
};

int ct_uart_open(struct ct_uart_device *uart);

int ct_uart_write(struct ct_uart_device *uart, uint8_t *data, size_t size);

int ct_uart_write_str(struct ct_uart_device *uart, char *str);

int ct_uart_write_byte(struct ct_uart_device *uart, uint8_t *byte);
```

## include/zbus_channels.h
```c
ZBUS_CHAN_DEFINE(
    version,              /* Name */
    false,                /* On changes only */
    true,                 /* Read only */
    struct version,       /* Message type */
    NULL,                 /* Validator */
    ZBUS_OBSERVERS_EMPTY, /* observers */
    ZBUS_MSG_INIT(.major = 0, .minor = 1,
                  .build = 1023) /* Initial value major 0, minor 1, build 1023 */
)
ZBUS_CHAN_DEFINE(
    sensor_data,           /* Name */
    true,                  /* On changes only */
    false,                 /* Read only */
    struct sensor_data,    /* Message type */
    NULL,                  /* Validator */
    ZBUS_OBSERVERS(proxy), /* observers */
    ZBUS_MSG_INIT(0)       /* Initial value {0} */
)
ZBUS_CHAN_DEFINE(
    start_measurement,          /* Name */
    false,                      /* On changes only */
    false,                      /* Read only */
    struct action,              /* Message type */
    NULL,                       /* Validator */
    ZBUS_OBSERVERS(proxy, peripheral), /* observers */
    ZBUS_MSG_INIT(false)        /* Initial value */
)
```

## include/zbus_messages.h
```c
#ifndef _ZBUS_MESSAGES_H_
#define _ZBUS_MESSAGES_H_
#include <zephyr.h>

struct version {
    uint8_t major;
    uint8_t minor;
    uint16_t build;
};

struct sensor_data {
    int value;
};

struct action {
    bool status;
};

#endif  // _ZBUS_MESSAGES_H_
```

## src/mock_proxy.c
```c
#include <kernel.h>
#include <net/buf.h>
#include <stdint.h>
#include <string.h>
#include <sys/crc.h>
#include <sys/printk.h>
#include <zephyr.h>
#include "ct_uart.h"
#include "zbus.h"

#include <logging/log.h>

LOG_MODULE_DECLARE(zbus, CONFIG_ZBUS_LOG_LEVEL);

K_MSGQ_DEFINE(_mock_proxy_input_msgq, sizeof(uint8_t), 256, 1);
K_MSGQ_DEFINE(_mock_proxy_output_msgq, sizeof(uint8_t), 256, 1);

struct ct_uart_device mock_proxy_uart = {DEVICE_DT_GET(DT_NODELABEL(uart1)),
                                         &_mock_proxy_input_msgq,
                                         &_mock_proxy_output_msgq};

void proxy_callback(zbus_chan_idx_t idx);

ZBUS_LISTENER_DECLARE(proxy, proxy_callback);

const uint8_t tokens[] = "$*";

void proxy_callback(zbus_chan_idx_t idx)
{
    LOG_DBG("[Mock Proxy callback] started (channel %d)", idx);
    struct zbus_channel *chan = zbus_chan_get_by_index(idx);
    if (!zbus_chan_claim(chan, K_NO_WAIT)) {
        bool *generated_by_the_bridge = (bool *) chan->user_data;
        if (*generated_by_the_bridge) {
            *generated_by_the_bridge = false;
            LOG_DBG("[Mock Proxy callback] filtered loopback event (channel %d)", idx);
        } else {
            ct_uart_write_byte(&mock_proxy_uart, (uint8_t *) &tokens[0]);
            ct_uart_write_byte(&mock_proxy_uart, (uint8_t *) &idx);
            ct_uart_write(&mock_proxy_uart, chan->message, chan->message_size);
            ct_uart_write(&mock_proxy_uart, (uint8_t *) &tokens[1], 1);
            LOG_DBG("[Mock Proxy callback] sending message to host (channel %d)", idx);
        }
        zbus_chan_finish(chan);
    }
}

void main(void)
{
    if (ct_uart_open(&mock_proxy_uart)) {
        return;
    }
    zbus_info_dump();
    LOG_DBG("[Mock Proxy] Started.");
}


void mock_proxy_rx_thread(void)
{
    LOG_DBG("[Mock Proxy RX] Started.");

    struct net_buf_simple *rx_buf = NET_BUF_SIMPLE(64);
    net_buf_simple_init(rx_buf, 0);

    uint8_t byte        = 0;
    zbus_chan_idx_t idx = ZBUS_CHAN_COUNT;
    while (1) {
        if (!k_msgq_get(&_mock_proxy_input_msgq, &byte, K_FOREVER)) {
            if (byte == '*') {
                if (rx_buf->len <= 1) {
                    LOG_DBG("[Mock Proxy RX] Discard invalid sequence");
                    /* '*' indicates the end of a sentence. Sometimes it is necessary to
                     * flush more than on ensure sending it from the python script. The
                     * code must discard when there is no other data at the buffer. */
                } else {
                    if ('$' == net_buf_simple_pull_u8(rx_buf)) {
                        LOG_DBG("[Mock Proxy RX] Found sentence");
                        idx = net_buf_simple_pull_u8(rx_buf);
                        if (idx < ZBUS_CHAN_COUNT) {
                            struct zbus_channel *chan = zbus_chan_get_by_index(idx);
                            if (!zbus_chan_claim(chan, K_NO_WAIT)) {
                                memcpy(
                                    chan->message,
                                    net_buf_simple_pull_mem(rx_buf, chan->message_size),
                                    chan->message_size);
                                bool *generated_by_the_bridge = (bool *) chan->user_data;
                                *generated_by_the_bridge      = true;
                                zbus_chan_finish(chan);
                                LOG_DBG("[Mock Proxy RX] Publishing channel %d", idx);
                                zbus_chan_notify(chan, K_MSEC(500));
                            }
                        }
                    }
                    net_buf_simple_init(rx_buf, 0);
                }
            } else {
                net_buf_simple_add_u8(rx_buf, byte);
            }
        }
    }
}

K_THREAD_DEFINE(mock_proxy_rx_thread_tid, 2048, mock_proxy_rx_thread, NULL, NULL, NULL, 1,
                0, 1500);
```

## src/peripheral.c
```c
/**
 * @file      peripheral.c
 * @brief     Header of
 * @date      Mon Nov 29 16:54:38 2021
 * @author    Rodrigo Peixoto
 * @copyright MIT
 *
 * This module
 */


#include <logging/log.h>
#include "zbus.h"
LOG_MODULE_DECLARE(zbus, CONFIG_ZBUS_LOG_LEVEL);

ZBUS_SUBSCRIBER_DECLARE(peripheral, 8);

void peripheral_thread(void)
{
    struct sensor_data sd    = {0};
    zbus_chan_idx_t idx = 0;
    while (!k_msgq_get(peripheral.queue, &idx, K_FOREVER)) {
        sd.value += 1;
        LOG_DBG("[Peripheral] sending sensor data");
        ZBUS_CHAN_PUB(sensor_data, sd, K_MSEC(250));
    }
}

K_THREAD_DEFINE(peripheral_thread_id, 1024, peripheral_thread, NULL, NULL, NULL, 3, 0, 0);
```
